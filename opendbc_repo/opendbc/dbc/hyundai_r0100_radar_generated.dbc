CM_ "AUTOGENERATED FILE, DO NOT EDIT";

CM_ "hyundai_r0100_radar.dbc starts here";
VERSION ""

NS_ :

BS_:

BU_: XXX RADAR

BO_ 384 RADAR_TRACK_180: 32 RADAR
 SG_ CHECKSUM : 0|16@1+ (1,0) [0|65535] "" XXX
 SG_ COUNTER : 16|8@1+ (1,0) [0|255] "" XXX
 SG_ 1_VALID_CNT : 32|8@1+ (1,0) [0|255] "" XXX
 SG_ 1_TRACK_ID : 42|8@1+ (1,0) [0|255] "" XXX
 SG_ 1_LONG_DIST : 64|13@1+ (0.05,0) [0|409.55] "m" XXX
 SG_ 1_LAT_DIST : 78|11@1- (0.05,0) [-51.2|51.15] "m" XXX
 SG_ 1_REL_SPEED : 91|11@1- (0.05,2.4) [-48.8|53.55] "m/s" XXX
 SG_ 1_LAT_SPEED_CANDIDATE : 104|9@1- (0.05,0.6) [-12.2|13.35] "m/s" XXX
 SG_ 1_REL_ACCEL_CANDIDATE : 115|9@1- (0.1,0) [-25.6|25.5] "m/s^2" XXX
 SG_ 1_HEARTBEAT : 124|4@1+ (1,0) [0|15] "" XXX
 SG_ 2_VALID_CNT : 160|8@1+ (1,0) [0|255] "" XXX
 SG_ 2_TRACK_ID : 170|8@1+ (1,0) [0|255] "" XXX
 SG_ 2_LONG_DIST : 192|13@1+ (0.05,0) [0|409.55] "m" XXX
 SG_ 2_LAT_DIST : 206|11@1- (0.05,0) [-51.2|51.15] "m" XXX
 SG_ 2_REL_SPEED : 219|11@1- (0.05,2.4) [-48.8|53.55] "m/s" XXX
 SG_ 2_LAT_SPEED_CANDIDATE : 232|9@1- (0.05,0.6) [-12.2|13.35] "m/s" XXX
 SG_ 2_REL_ACCEL_CANDIDATE : 243|9@1- (0.1,0) [-25.6|25.5] "m/s^2" XXX
 SG_ 2_HEARTBEAT : 252|4@1+ (1,0) [0|15] "" XXX

BO_ 385 RADAR_TRACK_181: 32 RADAR
 SG_ CHECKSUM : 0|16@1+ (1,0) [0|65535] "" XXX
 SG_ COUNTER : 16|8@1+ (1,0) [0|255] "" XXX
 SG_ 1_VALID_CNT : 32|8@1+ (1,0) [0|255] "" XXX
 SG_ 1_TRACK_ID : 42|8@1+ (1,0) [0|255] "" XXX
 SG_ 1_LONG_DIST : 64|13@1+ (0.05,0) [0|409.55] "m" XXX
 SG_ 1_LAT_DIST : 78|11@1- (0.05,0) [-51.2|51.15] "m" XXX
 SG_ 1_REL_SPEED : 91|11@1- (0.05,2.4) [-48.8|53.55] "m/s" XXX
 SG_ 1_LAT_SPEED_CANDIDATE : 104|9@1- (0.05,0.6) [-12.2|13.35] "m/s" XXX
 SG_ 1_REL_ACCEL_CANDIDATE : 115|9@1- (0.1,0) [-25.6|25.5] "m/s^2" XXX
 SG_ 1_HEARTBEAT : 124|4@1+ (1,0) [0|15] "" XXX
 SG_ 2_VALID_CNT : 160|8@1+ (1,0) [0|255] "" XXX
 SG_ 2_TRACK_ID : 170|8@1+ (1,0) [0|255] "" XXX
 SG_ 2_LONG_DIST : 192|13@1+ (0.05,0) [0|409.55] "m" XXX
 SG_ 2_LAT_DIST : 206|11@1- (0.05,0) [-51.2|51.15] "m" XXX
 SG_ 2_REL_SPEED : 219|11@1- (0.05,2.4) [-48.8|53.55] "m/s" XXX
 SG_ 2_LAT_SPEED_CANDIDATE : 232|9@1- (0.05,0.6) [-12.2|13.35] "m/s" XXX
 SG_ 2_REL_ACCEL_CANDIDATE : 243|9@1- (0.1,0) [-25.6|25.5] "m/s^2" XXX
 SG_ 2_HEARTBEAT : 252|4@1+ (1,0) [0|15] "" XXX

BO_ 386 RADAR_TRACK_182: 32 RADAR
 SG_ CHECKSUM : 0|16@1+ (1,0) [0|65535] "" XXX
 SG_ COUNTER : 16|8@1+ (1,0) [0|255] "" XXX
 SG_ 1_VALID_CNT : 32|8@1+ (1,0) [0|255] "" XXX
 SG_ 1_TRACK_ID : 42|8@1+ (1,0) [0|255] "" XXX
 SG_ 1_LONG_DIST : 64|13@1+ (0.05,0) [0|409.55] "m" XXX
 SG_ 1_LAT_DIST : 78|11@1- (0.05,0) [-51.2|51.15] "m" XXX
 SG_ 1_REL_SPEED : 91|11@1- (0.05,2.4) [-48.8|53.55] "m/s" XXX
 SG_ 1_LAT_SPEED_CANDIDATE : 104|9@1- (0.05,0.6) [-12.2|13.35] "m/s" XXX
 SG_ 1_REL_ACCEL_CANDIDATE : 115|9@1- (0.1,0) [-25.6|25.5] "m/s^2" XXX
 SG_ 1_HEARTBEAT : 124|4@1+ (1,0) [0|15] "" XXX
 SG_ 2_VALID_CNT : 160|8@1+ (1,0) [0|255] "" XXX
 SG_ 2_TRACK_ID : 170|8@1+ (1,0) [0|255] "" XXX
 SG_ 2_LONG_DIST : 192|13@1+ (0.05,0) [0|409.55] "m" XXX
 SG_ 2_LAT_DIST : 206|11@1- (0.05,0) [-51.2|51.15] "m" XXX
 SG_ 2_REL_SPEED : 219|11@1- (0.05,2.4) [-48.8|53.55] "m/s" XXX
 SG_ 2_LAT_SPEED_CANDIDATE : 232|9@1- (0.05,0.6) [-12.2|13.35] "m/s" XXX
 SG_ 2_REL_ACCEL_CANDIDATE : 243|9@1- (0.1,0) [-25.6|25.5] "m/s^2" XXX
 SG_ 2_HEARTBEAT : 252|4@1+ (1,0) [0|15] "" XXX

BO_ 387 RADAR_TRACK_183: 32 RADAR
 SG_ CHECKSUM : 0|16@1+ (1,0) [0|65535] "" XXX
 SG_ COUNTER : 16|8@1+ (1,0) [0|255] "" XXX
 SG_ 1_VALID_CNT : 32|8@1+ (1,0) [0|255] "" XXX
 SG_ 1_TRACK_ID : 42|8@1+ (1,0) [0|255] "" XXX
 SG_ 1_LONG_DIST : 64|13@1+ (0.05,0) [0|409.55] "m" XXX
 SG_ 1_LAT_DIST : 78|11@1- (0.05,0) [-51.2|51.15] "m" XXX
 SG_ 1_REL_SPEED : 91|11@1- (0.05,2.4) [-48.8|53.55] "m/s" XXX
 SG_ 1_LAT_SPEED_CANDIDATE : 104|9@1- (0.05,0.6) [-12.2|13.35] "m/s" XXX
 SG_ 1_REL_ACCEL_CANDIDATE : 115|9@1- (0.1,0) [-25.6|25.5] "m/s^2" XXX
 SG_ 1_HEARTBEAT : 124|4@1+ (1,0) [0|15] "" XXX
 SG_ 2_VALID_CNT : 160|8@1+ (1,0) [0|255] "" XXX
 SG_ 2_TRACK_ID : 170|8@1+ (1,0) [0|255] "" XXX
 SG_ 2_LONG_DIST : 192|13@1+ (0.05,0) [0|409.55] "m" XXX
 SG_ 2_LAT_DIST : 206|11@1- (0.05,0) [-51.2|51.15] "m" XXX
 SG_ 2_REL_SPEED : 219|11@1- (0.05,2.4) [-48.8|53.55] "m/s" XXX
 SG_ 2_LAT_SPEED_CANDIDATE : 232|9@1- (0.05,0.6) [-12.2|13.35] "m/s" XXX
 SG_ 2_REL_ACCEL_CANDIDATE : 243|9@1- (0.1,0) [-25.6|25.5] "m/s^2" XXX
 SG_ 2_HEARTBEAT : 252|4@1+ (1,0) [0|15] "" XXX

BO_ 388 RADAR_TRACK_184: 32 RADAR
 SG_ CHECKSUM : 0|16@1+ (1,0) [0|65535] "" XXX
 SG_ COUNTER : 16|8@1+ (1,0) [0|255] "" XXX
 SG_ 1_VALID_CNT : 32|8@1+ (1,0) [0|255] "" XXX
 SG_ 1_TRACK_ID : 42|8@1+ (1,0) [0|255] "" XXX
 SG_ 1_LONG_DIST : 64|13@1+ (0.05,0) [0|409.55] "m" XXX
 SG_ 1_LAT_DIST : 78|11@1- (0.05,0) [-51.2|51.15] "m" XXX
 SG_ 1_REL_SPEED : 91|11@1- (0.05,2.4) [-48.8|53.55] "m/s" XXX
 SG_ 1_LAT_SPEED_CANDIDATE : 104|9@1- (0.05,0.6) [-12.2|13.35] "m/s" XXX
 SG_ 1_REL_ACCEL_CANDIDATE : 115|9@1- (0.1,0) [-25.6|25.5] "m/s^2" XXX
 SG_ 1_HEARTBEAT : 124|4@1+ (1,0) [0|15] "" XXX
 SG_ 2_VALID_CNT : 160|8@1+ (1,0) [0|255] "" XXX
 SG_ 2_TRACK_ID : 170|8@1+ (1,0) [0|255] "" XXX
 SG_ 2_LONG_DIST : 192|13@1+ (0.05,0) [0|409.55] "m" XXX
 SG_ 2_LAT_DIST : 206|11@1- (0.05,0) [-51.2|51.15] "m" XXX
 SG_ 2_REL_SPEED : 219|11@1- (0.05,2.4) [-48.8|53.55] "m/s" XXX
 SG_ 2_LAT_SPEED_CANDIDATE : 232|9@1- (0.05,0.6) [-12.2|13.35] "m/s" XXX
 SG_ 2_REL_ACCEL_CANDIDATE : 243|9@1- (0.1,0) [-25.6|25.5] "m/s^2" XXX
 SG_ 2_HEARTBEAT : 252|4@1+ (1,0) [0|15] "" XXX
